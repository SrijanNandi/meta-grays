## conf/layer.conf
```bitbake
# We have a conf and classes directory, add to BBPATH
BBPATH .= ":${LAYERDIR}"

# We have recipes-* directories, add to BBFILES
BBFILES += "${LAYERDIR}/recipes-*/*/*.bb \
            ${LAYERDIR}/recipes-*/*/*.bbappend"

BBFILE_COLLECTIONS += "meta-grays"
BBFILE_PATTERN_meta-grays = "^${LAYERDIR}/"
BBFILE_PRIORITY_meta-grays = "6"

LAYERDEPENDS_meta-grays = "core"
LAYERSERIES_COMPAT_meta-grays = "warrior zeus dunfell"
```
